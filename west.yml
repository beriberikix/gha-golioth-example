## west.yml
```yaml
manifest:
  projects:
    - name: zephyr
      revision: v3.2.0
      url: https://github.com/zephyrproject-rtos/zephyr
      import:
        name-allowlist:
          - hal_espressif
          - mbedtls
          - mcuboot
    - name: golioth
      path: modules/lib/golioth
      revision: main
      url: https://github.com/golioth/golioth-zephyr-sdk.git
      import: west-external.yml
```
